/* Generated from spec/board.json by tools/gen.py -- DO NOT EDIT; edit the spec and run `make gen`. */

	.equ CPU_CLOCK_HZ, 12000000
	.equ RAM_BASE, 0x000000
	.equ RAM_SIZE, 0x040000
	.equ RAM_END, 0x040000
	.equ ROM_BASE, 0xE00000
	.equ ROM_SIZE, 0x020000
	.equ ROM_END, 0xE20000
	.equ IO_BASE, 0xF00000
	.equ IO_SIZE, 0x010000
	.equ IO_END, 0xF10000
	.equ SWITCHES_BASE, 0xF10000
	.equ SWITCHES_SIZE, 0x010000
	.equ SWITCHES_END, 0xF20000
	.equ DUART_BASE, 0xF20000
	.equ DUART_SIZE, 0x010000
	.equ DUART_END, 0xF30000
	.equ VECTORS_BASE, 0x000000
	.equ VECTORS_SIZE, 0x000400
	.equ VECTORS_END, 0x000400
	.equ SYSDATA_BASE, 0x000400
	.equ SYSDATA_SIZE, 0x003C00
	.equ SYSDATA_END, 0x004000
	.equ USER_BASE, 0x004000
	.equ USER_SIZE, 0x016800
	.equ USER_END, 0x01A800
	.equ FB1_BASE, 0x01A800
	.equ FB1_SIZE, 0x012C00
	.equ FB1_END, 0x02D400
	.equ FB0_BASE, 0x02D400
	.equ FB0_SIZE, 0x012C00
	.equ FB0_END, 0x040000
	.equ SYS_STACK_TOP, 0x004000
	.equ VIDEO_WIDTH, 320
	.equ VIDEO_HEIGHT, 240
	.equ VIDEO_BPP, 8
	.equ VIDEO_BYTES_PER_LINE, 320
	.equ FB_SIZE, 76800
	.equ FB_PAGE0_ADDR, 0x02D400
	.equ FB_PAGE1_ADDR, 0x01A800
	.equ VIDEO_NTSC_LINE_CLOCKS, 764
	.equ VIDEO_NTSC_H_ACTIVE, 640
	.equ VIDEO_NTSC_H_FRONT, 16
	.equ VIDEO_NTSC_H_SYNC, 56
	.equ VIDEO_NTSC_H_BACK, 52
	.equ VIDEO_NTSC_LINES, 262
	.equ VIDEO_NTSC_V_ACTIVE, 240
	.equ VIDEO_NTSC_V_BOTTOM, 3
	.equ VIDEO_NTSC_V_SYNC, 3
	.equ VIDEO_NTSC_V_TOP, 16
	.equ VIDEO_PAL_LINE_CLOCKS, 768
	.equ VIDEO_PAL_H_ACTIVE, 640
	.equ VIDEO_PAL_H_FRONT, 16
	.equ VIDEO_PAL_H_SYNC, 56
	.equ VIDEO_PAL_H_BACK, 56
	.equ VIDEO_PAL_LINES, 312
	.equ VIDEO_PAL_V_ACTIVE, 240
	.equ VIDEO_PAL_V_BOTTOM, 30
	.equ VIDEO_PAL_V_SYNC, 3
	.equ VIDEO_PAL_V_TOP, 39
	.equ IO_BASE, 0xF00000
	.equ IO_INTSTAT_ADDR, 0xF00000
	.equ IO_INTSTAT_OFFSET, 0
	.equ INTSTAT_VBLANK_BIT, 0
	.equ INTSTAT_VBLANK_MASK, 0x0001
	.equ INTSTAT_HSYNC_BIT, 1
	.equ INTSTAT_HSYNC_MASK, 0x0002
	.equ INTSTAT_PS2RDY_BIT, 2
	.equ INTSTAT_PS2RDY_MASK, 0x0004
	.equ INTSTAT_DUARTIRQ_BIT, 3
	.equ INTSTAT_DUARTIRQ_MASK, 0x0008
	.equ INTSTAT_PS2ERR_BIT, 5
	.equ INTSTAT_PS2ERR_MASK, 0x0020
	.equ INTSTAT_NMIBTN_BIT, 7
	.equ INTSTAT_NMIBTN_MASK, 0x0080
	.equ INTSTAT_SDMISO_BIT, 8
	.equ INTSTAT_SDMISO_MASK, 0x0100
	.equ INTSTAT_PS2CLK_BIT, 9
	.equ INTSTAT_PS2CLK_MASK, 0x0200
	.equ INTSTAT_PS2DAT_BIT, 10
	.equ INTSTAT_PS2DAT_MASK, 0x0400
	.equ INTSTAT_PALJMP_BIT, 12
	.equ INTSTAT_PALJMP_MASK, 0x1000
	.equ INTSTAT_VSYNCPIN_BIT, 13
	.equ INTSTAT_VSYNCPIN_MASK, 0x2000
	.equ INTSTAT_DEPIN_BIT, 14
	.equ INTSTAT_DEPIN_MASK, 0x4000
	.equ INTSTAT_HSYNCPIN_BIT, 15
	.equ INTSTAT_HSYNCPIN_MASK, 0x8000
	.equ IO_INTEN_ADDR, 0xF00002
	.equ IO_INTEN_OFFSET, 2
	.equ IO_INTEN_RESET, 0x0000
	.equ INTEN_VBLANK_BIT, 0
	.equ INTEN_VBLANK_MASK, 0x0001
	.equ INTEN_HSYNC_BIT, 1
	.equ INTEN_HSYNC_MASK, 0x0002
	.equ INTEN_PS2_BIT, 2
	.equ INTEN_PS2_MASK, 0x0004
	.equ INTEN_DUART_BIT, 3
	.equ INTEN_DUART_MASK, 0x0008
	.equ IO_SDIO_ADDR, 0xF00004
	.equ IO_SDIO_OFFSET, 4
	.equ IO_SDIO_RESET, 0x0001
	.equ SDIO_CS_BIT, 0
	.equ SDIO_CS_MASK, 0x0001
	.equ SDIO_CLK_BIT, 1
	.equ SDIO_CLK_MASK, 0x0002
	.equ SDIO_MOSI_BIT, 2
	.equ SDIO_MOSI_MASK, 0x0004
	.equ IO_GPIO_ADDR, 0xF00006
	.equ IO_GPIO_OFFSET, 6
	.equ IO_GPIO_RESET, 0x0003
	.equ GPIO_PS2CLK_BIT, 0
	.equ GPIO_PS2CLK_MASK, 0x0001
	.equ GPIO_PS2DAT_BIT, 1
	.equ GPIO_PS2DAT_MASK, 0x0002
	.equ GPIO_AUDIO_BIT, 2
	.equ GPIO_AUDIO_MASK, 0x0004
	.equ GPIO_LED0_BIT, 3
	.equ GPIO_LED0_MASK, 0x0008
	.equ GPIO_LED1_BIT, 4
	.equ GPIO_LED1_MASK, 0x0010
	.equ IO_PS2DATA_ADDR, 0xF00008
	.equ IO_PS2DATA_OFFSET, 8
	.equ PS2DATA_DATA_BIT, 0
	.equ PS2DATA_DATA_MASK, 0x00FF
	.equ IO_USERIO_ADDR, 0xF0000C
	.equ IO_USERIO_OFFSET, 12
	.equ IO_USERIO_RESET, 0x000F
	.equ USERIO_OUT_BIT, 0
	.equ USERIO_OUT_MASK, 0x000F
	.equ USERIO_IN_BIT, 8
	.equ USERIO_IN_MASK, 0x0F00
	.equ IO_ID_ADDR, 0xF0000E
	.equ IO_ID_OFFSET, 14
	.equ IO_ID_RESET, 0x6802
	.equ ID_REV_BIT, 0
	.equ ID_REV_MASK, 0x00FF
	.equ ID_MAGIC_BIT, 8
	.equ ID_MAGIC_MASK, 0xFF00
	.equ SW_BASE, 0xF10000
	.equ SW_PAGE0_ADDR, 0xF10000
	.equ SW_PAGE0_OFFSET, 0
	.equ SW_PAGE1_ADDR, 0xF10002
	.equ SW_PAGE1_OFFSET, 2
	.equ SW_NTSC_ADDR, 0xF10004
	.equ SW_NTSC_OFFSET, 4
	.equ SW_PAL_ADDR, 0xF10006
	.equ SW_PAL_OFFSET, 6
	.equ DUART_BASE, 0xF20000
	.equ DUART_MRA_ADDR, 0xF20001
	.equ DUART_MRA_OFFSET, 1
	.equ DUART_SRA_ADDR, 0xF20003
	.equ DUART_SRA_OFFSET, 3
	.equ SRA_RXRDY_BIT, 0
	.equ SRA_RXRDY_MASK, 0x0001
	.equ SRA_FFULL_BIT, 1
	.equ SRA_FFULL_MASK, 0x0002
	.equ SRA_TXRDY_BIT, 2
	.equ SRA_TXRDY_MASK, 0x0004
	.equ SRA_TXEMT_BIT, 3
	.equ SRA_TXEMT_MASK, 0x0008
	.equ SRA_OE_BIT, 4
	.equ SRA_OE_MASK, 0x0010
	.equ SRA_PE_BIT, 5
	.equ SRA_PE_MASK, 0x0020
	.equ SRA_FE_BIT, 6
	.equ SRA_FE_MASK, 0x0040
	.equ SRA_RB_BIT, 7
	.equ SRA_RB_MASK, 0x0080
	.equ DUART_CSRA_ADDR, 0xF20003
	.equ DUART_CSRA_OFFSET, 3
	.equ DUART_CRA_ADDR, 0xF20005
	.equ DUART_CRA_OFFSET, 5
	.equ DUART_RBA_ADDR, 0xF20007
	.equ DUART_RBA_OFFSET, 7
	.equ DUART_TBA_ADDR, 0xF20007
	.equ DUART_TBA_OFFSET, 7
	.equ DUART_IPCR_ADDR, 0xF20009
	.equ DUART_IPCR_OFFSET, 9
	.equ DUART_ACR_ADDR, 0xF20009
	.equ DUART_ACR_OFFSET, 9
	.equ DUART_ISR_ADDR, 0xF2000B
	.equ DUART_ISR_OFFSET, 11
	.equ ISR_TXRDYA_BIT, 0
	.equ ISR_TXRDYA_MASK, 0x0001
	.equ ISR_RXRDYA_BIT, 1
	.equ ISR_RXRDYA_MASK, 0x0002
	.equ ISR_DBA_BIT, 2
	.equ ISR_DBA_MASK, 0x0004
	.equ ISR_CTR_BIT, 3
	.equ ISR_CTR_MASK, 0x0008
	.equ ISR_TXRDYB_BIT, 4
	.equ ISR_TXRDYB_MASK, 0x0010
	.equ ISR_RXRDYB_BIT, 5
	.equ ISR_RXRDYB_MASK, 0x0020
	.equ ISR_DBB_BIT, 6
	.equ ISR_DBB_MASK, 0x0040
	.equ ISR_IPC_BIT, 7
	.equ ISR_IPC_MASK, 0x0080
	.equ DUART_IMR_ADDR, 0xF2000B
	.equ DUART_IMR_OFFSET, 11
	.equ IMR_TXRDYA_BIT, 0
	.equ IMR_TXRDYA_MASK, 0x0001
	.equ IMR_RXRDYA_BIT, 1
	.equ IMR_RXRDYA_MASK, 0x0002
	.equ IMR_DBA_BIT, 2
	.equ IMR_DBA_MASK, 0x0004
	.equ IMR_CTR_BIT, 3
	.equ IMR_CTR_MASK, 0x0008
	.equ IMR_TXRDYB_BIT, 4
	.equ IMR_TXRDYB_MASK, 0x0010
	.equ IMR_RXRDYB_BIT, 5
	.equ IMR_RXRDYB_MASK, 0x0020
	.equ IMR_DBB_BIT, 6
	.equ IMR_DBB_MASK, 0x0040
	.equ IMR_IPC_BIT, 7
	.equ IMR_IPC_MASK, 0x0080
	.equ DUART_CUR_ADDR, 0xF2000D
	.equ DUART_CUR_OFFSET, 13
	.equ DUART_CTUR_ADDR, 0xF2000D
	.equ DUART_CTUR_OFFSET, 13
	.equ DUART_CLR_ADDR, 0xF2000F
	.equ DUART_CLR_OFFSET, 15
	.equ DUART_CTLR_ADDR, 0xF2000F
	.equ DUART_CTLR_OFFSET, 15
	.equ DUART_MRB_ADDR, 0xF20011
	.equ DUART_MRB_OFFSET, 17
	.equ DUART_SRB_ADDR, 0xF20013
	.equ DUART_SRB_OFFSET, 19
	.equ SRB_RXRDY_BIT, 0
	.equ SRB_RXRDY_MASK, 0x0001
	.equ SRB_FFULL_BIT, 1
	.equ SRB_FFULL_MASK, 0x0002
	.equ SRB_TXRDY_BIT, 2
	.equ SRB_TXRDY_MASK, 0x0004
	.equ SRB_TXEMT_BIT, 3
	.equ SRB_TXEMT_MASK, 0x0008
	.equ SRB_OE_BIT, 4
	.equ SRB_OE_MASK, 0x0010
	.equ SRB_PE_BIT, 5
	.equ SRB_PE_MASK, 0x0020
	.equ SRB_FE_BIT, 6
	.equ SRB_FE_MASK, 0x0040
	.equ SRB_RB_BIT, 7
	.equ SRB_RB_MASK, 0x0080
	.equ DUART_CSRB_ADDR, 0xF20013
	.equ DUART_CSRB_OFFSET, 19
	.equ DUART_CRB_ADDR, 0xF20015
	.equ DUART_CRB_OFFSET, 21
	.equ DUART_RBB_ADDR, 0xF20017
	.equ DUART_RBB_OFFSET, 23
	.equ DUART_TBB_ADDR, 0xF20017
	.equ DUART_TBB_OFFSET, 23
	.equ DUART_IVR_ADDR, 0xF20019
	.equ DUART_IVR_OFFSET, 25
	.equ DUART_IP_ADDR, 0xF2001B
	.equ DUART_IP_OFFSET, 27
	.equ DUART_OPCR_ADDR, 0xF2001B
	.equ DUART_OPCR_OFFSET, 27
	.equ DUART_START_CTR_ADDR, 0xF2001D
	.equ DUART_START_CTR_OFFSET, 29
	.equ DUART_OPR_SET_ADDR, 0xF2001D
	.equ DUART_OPR_SET_OFFSET, 29
	.equ DUART_STOP_CTR_ADDR, 0xF2001F
	.equ DUART_STOP_CTR_OFFSET, 31
	.equ DUART_OPR_RESET_ADDR, 0xF2001F
	.equ DUART_OPR_RESET_OFFSET, 31
	.equ IRQ_VBLANK_LEVEL, 1
	.equ IRQ_VBLANK_VECTOR_ADDR, 0x064
	.equ IRQ_PS2_LEVEL, 2
	.equ IRQ_PS2_VECTOR_ADDR, 0x068
	.equ IRQ_DUART_LEVEL, 3
	.equ IRQ_DUART_VECTOR_ADDR, 0x06C
	.equ IRQ_HSYNC_LEVEL, 4
	.equ IRQ_HSYNC_VECTOR_ADDR, 0x070
	.equ IRQ_NMI_LEVEL, 7
	.equ IRQ_NMI_VECTOR_ADDR, 0x07C
	.equ SYSCALL_TRAP, 15
	.equ SERIAL_BAUD, 38400
	.equ SERIAL_CSR_VALUE, 0xCC
	.equ SERIAL_ACR_BRG_SET, 0
	.equ SERIAL_ACR_VALUE, 0x00
	.equ SERIAL_MR1_VALUE, 0x13
	.equ SERIAL_MR2_VALUE, 0x07
	.equ DUART_CR_RESET_MR, 0x10
	.equ DUART_CR_RESET_RX, 0x20
	.equ DUART_CR_RESET_TX, 0x30
	.equ DUART_CR_RESET_ERR, 0x40
	.equ DUART_CR_RESET_BRK, 0x50
	.equ DUART_CR_ENABLE, 0x05

	.equ SYS_exit, 0
	.equ SYS_putchar, 1
	.equ SYS_getchar, 2
	.equ SYS_pollchar, 3
	.equ SYS_puts, 4
	.equ SYS_serial_putc, 5
	.equ SYS_serial_getc, 6
	.equ SYS_ticks, 7
	.equ SYS_wait_vblank, 8
	.equ SYS_video_info, 9
	.equ SYS_video_set_page, 10
	.equ SYS_open, 11
	.equ SYS_close, 12
	.equ SYS_read, 13
	.equ SYS_write, 14
	.equ SYS_lseek, 15
	.equ SYS_opendir, 16
	.equ SYS_readdir, 17
	.equ SYS_closedir, 18
	.equ SYS_sd_read_block, 19
	.equ SYS_sd_write_block, 20
	.equ SYS_set_irq_handler, 21
	.equ SYS_mem_info, 22
	.equ SYS_con_set_cursor, 23
	.equ SYS_con_clear, 24
	.equ SYS_con_info, 25
	.equ SYS_exec, 26
	.equ SYS_key_event, 27
	.equ SYS_sleep_ms, 28
	.equ SYS_set_audio_cb, 29
